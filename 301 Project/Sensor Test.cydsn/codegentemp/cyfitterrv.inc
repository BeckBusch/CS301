;
; File Name: cyfitterrv.inc
; 
; PSoC Creator  4.2
;
; Description:
; 
;
;-------------------------------------------------------------------------------
; Copyright (c) 2007-2018 Cypress Semiconductor.  All rights reserved.
; You may use this file only in accordance with the license, terms, conditions, 
; disclaimers, and limitations in the end user license agreement accompanying 
; the software package with which this file was provided.
;-------------------------------------------------------------------------------

    IF :LNOT::DEF:INCLUDED_CYFITTERRV_INC
INCLUDED_CYFITTERRV_INC EQU 1
    GET cydevicerv.inc
    GET cydevicerv_trm.inc

; LED_1
LED_1__0__INTTYPE EQU CYREG_PICU2_INTTYPE7
LED_1__0__MASK EQU 0x80
LED_1__0__PC EQU CYREG_PRT2_PC7
LED_1__0__PORT EQU 2
LED_1__0__SHIFT EQU 7
LED_1__AG EQU CYREG_PRT2_AG
LED_1__AMUX EQU CYREG_PRT2_AMUX
LED_1__BIE EQU CYREG_PRT2_BIE
LED_1__BIT_MASK EQU CYREG_PRT2_BIT_MASK
LED_1__BYP EQU CYREG_PRT2_BYP
LED_1__CTL EQU CYREG_PRT2_CTL
LED_1__DM0 EQU CYREG_PRT2_DM0
LED_1__DM1 EQU CYREG_PRT2_DM1
LED_1__DM2 EQU CYREG_PRT2_DM2
LED_1__DR EQU CYREG_PRT2_DR
LED_1__INP_DIS EQU CYREG_PRT2_INP_DIS
LED_1__INTTYPE_BASE EQU CYDEV_PICU_INTTYPE_PICU2_BASE
LED_1__LCD_COM_SEG EQU CYREG_PRT2_LCD_COM_SEG
LED_1__LCD_EN EQU CYREG_PRT2_LCD_EN
LED_1__MASK EQU 0x80
LED_1__PORT EQU 2
LED_1__PRT EQU CYREG_PRT2_PRT
LED_1__PRTDSI__CAPS_SEL EQU CYREG_PRT2_CAPS_SEL
LED_1__PRTDSI__DBL_SYNC_IN EQU CYREG_PRT2_DBL_SYNC_IN
LED_1__PRTDSI__OE_SEL0 EQU CYREG_PRT2_OE_SEL0
LED_1__PRTDSI__OE_SEL1 EQU CYREG_PRT2_OE_SEL1
LED_1__PRTDSI__OUT_SEL0 EQU CYREG_PRT2_OUT_SEL0
LED_1__PRTDSI__OUT_SEL1 EQU CYREG_PRT2_OUT_SEL1
LED_1__PRTDSI__SYNC_OUT EQU CYREG_PRT2_SYNC_OUT
LED_1__PS EQU CYREG_PRT2_PS
LED_1__SHIFT EQU 7
LED_1__SLW EQU CYREG_PRT2_SLW

; LED_2
LED_2__0__INTTYPE EQU CYREG_PICU2_INTTYPE5
LED_2__0__MASK EQU 0x20
LED_2__0__PC EQU CYREG_PRT2_PC5
LED_2__0__PORT EQU 2
LED_2__0__SHIFT EQU 5
LED_2__AG EQU CYREG_PRT2_AG
LED_2__AMUX EQU CYREG_PRT2_AMUX
LED_2__BIE EQU CYREG_PRT2_BIE
LED_2__BIT_MASK EQU CYREG_PRT2_BIT_MASK
LED_2__BYP EQU CYREG_PRT2_BYP
LED_2__CTL EQU CYREG_PRT2_CTL
LED_2__DM0 EQU CYREG_PRT2_DM0
LED_2__DM1 EQU CYREG_PRT2_DM1
LED_2__DM2 EQU CYREG_PRT2_DM2
LED_2__DR EQU CYREG_PRT2_DR
LED_2__INP_DIS EQU CYREG_PRT2_INP_DIS
LED_2__INTTYPE_BASE EQU CYDEV_PICU_INTTYPE_PICU2_BASE
LED_2__LCD_COM_SEG EQU CYREG_PRT2_LCD_COM_SEG
LED_2__LCD_EN EQU CYREG_PRT2_LCD_EN
LED_2__MASK EQU 0x20
LED_2__PORT EQU 2
LED_2__PRT EQU CYREG_PRT2_PRT
LED_2__PRTDSI__CAPS_SEL EQU CYREG_PRT2_CAPS_SEL
LED_2__PRTDSI__DBL_SYNC_IN EQU CYREG_PRT2_DBL_SYNC_IN
LED_2__PRTDSI__OE_SEL0 EQU CYREG_PRT2_OE_SEL0
LED_2__PRTDSI__OE_SEL1 EQU CYREG_PRT2_OE_SEL1
LED_2__PRTDSI__OUT_SEL0 EQU CYREG_PRT2_OUT_SEL0
LED_2__PRTDSI__OUT_SEL1 EQU CYREG_PRT2_OUT_SEL1
LED_2__PRTDSI__SYNC_OUT EQU CYREG_PRT2_SYNC_OUT
LED_2__PS EQU CYREG_PRT2_PS
LED_2__SHIFT EQU 5
LED_2__SLW EQU CYREG_PRT2_SLW

; LED_3
LED_3__0__INTTYPE EQU CYREG_PICU2_INTTYPE1
LED_3__0__MASK EQU 0x02
LED_3__0__PC EQU CYREG_PRT2_PC1
LED_3__0__PORT EQU 2
LED_3__0__SHIFT EQU 1
LED_3__AG EQU CYREG_PRT2_AG
LED_3__AMUX EQU CYREG_PRT2_AMUX
LED_3__BIE EQU CYREG_PRT2_BIE
LED_3__BIT_MASK EQU CYREG_PRT2_BIT_MASK
LED_3__BYP EQU CYREG_PRT2_BYP
LED_3__CTL EQU CYREG_PRT2_CTL
LED_3__DM0 EQU CYREG_PRT2_DM0
LED_3__DM1 EQU CYREG_PRT2_DM1
LED_3__DM2 EQU CYREG_PRT2_DM2
LED_3__DR EQU CYREG_PRT2_DR
LED_3__INP_DIS EQU CYREG_PRT2_INP_DIS
LED_3__INTTYPE_BASE EQU CYDEV_PICU_INTTYPE_PICU2_BASE
LED_3__LCD_COM_SEG EQU CYREG_PRT2_LCD_COM_SEG
LED_3__LCD_EN EQU CYREG_PRT2_LCD_EN
LED_3__MASK EQU 0x02
LED_3__PORT EQU 2
LED_3__PRT EQU CYREG_PRT2_PRT
LED_3__PRTDSI__CAPS_SEL EQU CYREG_PRT2_CAPS_SEL
LED_3__PRTDSI__DBL_SYNC_IN EQU CYREG_PRT2_DBL_SYNC_IN
LED_3__PRTDSI__OE_SEL0 EQU CYREG_PRT2_OE_SEL0
LED_3__PRTDSI__OE_SEL1 EQU CYREG_PRT2_OE_SEL1
LED_3__PRTDSI__OUT_SEL0 EQU CYREG_PRT2_OUT_SEL0
LED_3__PRTDSI__OUT_SEL1 EQU CYREG_PRT2_OUT_SEL1
LED_3__PRTDSI__SYNC_OUT EQU CYREG_PRT2_SYNC_OUT
LED_3__PS EQU CYREG_PRT2_PS
LED_3__SHIFT EQU 1
LED_3__SLW EQU CYREG_PRT2_SLW

; Timer_1
Timer_1_TimerHW__CAP0 EQU CYREG_TMR0_CAP0
Timer_1_TimerHW__CAP1 EQU CYREG_TMR0_CAP1
Timer_1_TimerHW__CFG0 EQU CYREG_TMR0_CFG0
Timer_1_TimerHW__CFG1 EQU CYREG_TMR0_CFG1
Timer_1_TimerHW__CFG2 EQU CYREG_TMR0_CFG2
Timer_1_TimerHW__CNT_CMP0 EQU CYREG_TMR0_CNT_CMP0
Timer_1_TimerHW__CNT_CMP1 EQU CYREG_TMR0_CNT_CMP1
Timer_1_TimerHW__PER0 EQU CYREG_TMR0_PER0
Timer_1_TimerHW__PER1 EQU CYREG_TMR0_PER1
Timer_1_TimerHW__PM_ACT_CFG EQU CYREG_PM_ACT_CFG3
Timer_1_TimerHW__PM_ACT_MSK EQU 0x01
Timer_1_TimerHW__PM_STBY_CFG EQU CYREG_PM_STBY_CFG3
Timer_1_TimerHW__PM_STBY_MSK EQU 0x01
Timer_1_TimerHW__RT0 EQU CYREG_TMR0_RT0
Timer_1_TimerHW__RT1 EQU CYREG_TMR0_RT1
Timer_1_TimerHW__SR0 EQU CYREG_TMR0_SR0

; ADC_SAR_1
ADC_SAR_1_ADC_SAR__CLK EQU CYREG_SAR0_CLK
ADC_SAR_1_ADC_SAR__CSR0 EQU CYREG_SAR0_CSR0
ADC_SAR_1_ADC_SAR__CSR1 EQU CYREG_SAR0_CSR1
ADC_SAR_1_ADC_SAR__CSR2 EQU CYREG_SAR0_CSR2
ADC_SAR_1_ADC_SAR__CSR3 EQU CYREG_SAR0_CSR3
ADC_SAR_1_ADC_SAR__CSR4 EQU CYREG_SAR0_CSR4
ADC_SAR_1_ADC_SAR__CSR5 EQU CYREG_SAR0_CSR5
ADC_SAR_1_ADC_SAR__CSR6 EQU CYREG_SAR0_CSR6
ADC_SAR_1_ADC_SAR__PM_ACT_CFG EQU CYREG_PM_ACT_CFG11
ADC_SAR_1_ADC_SAR__PM_ACT_MSK EQU 0x01
ADC_SAR_1_ADC_SAR__PM_STBY_CFG EQU CYREG_PM_STBY_CFG11
ADC_SAR_1_ADC_SAR__PM_STBY_MSK EQU 0x01
ADC_SAR_1_ADC_SAR__SW0 EQU CYREG_SAR0_SW0
ADC_SAR_1_ADC_SAR__SW2 EQU CYREG_SAR0_SW2
ADC_SAR_1_ADC_SAR__SW3 EQU CYREG_SAR0_SW3
ADC_SAR_1_ADC_SAR__SW4 EQU CYREG_SAR0_SW4
ADC_SAR_1_ADC_SAR__SW6 EQU CYREG_SAR0_SW6
ADC_SAR_1_ADC_SAR__TR0 EQU CYREG_SAR0_TR0
ADC_SAR_1_ADC_SAR__WRK0 EQU CYREG_SAR0_WRK0
ADC_SAR_1_ADC_SAR__WRK1 EQU CYREG_SAR0_WRK1
ADC_SAR_1_Bypass__0__INTTYPE EQU CYREG_PICU0_INTTYPE4
ADC_SAR_1_Bypass__0__MASK EQU 0x10
ADC_SAR_1_Bypass__0__PC EQU CYREG_PRT0_PC4
ADC_SAR_1_Bypass__0__PORT EQU 0
ADC_SAR_1_Bypass__0__SHIFT EQU 4
ADC_SAR_1_Bypass__AG EQU CYREG_PRT0_AG
ADC_SAR_1_Bypass__AMUX EQU CYREG_PRT0_AMUX
ADC_SAR_1_Bypass__BIE EQU CYREG_PRT0_BIE
ADC_SAR_1_Bypass__BIT_MASK EQU CYREG_PRT0_BIT_MASK
ADC_SAR_1_Bypass__BYP EQU CYREG_PRT0_BYP
ADC_SAR_1_Bypass__CTL EQU CYREG_PRT0_CTL
ADC_SAR_1_Bypass__DM0 EQU CYREG_PRT0_DM0
ADC_SAR_1_Bypass__DM1 EQU CYREG_PRT0_DM1
ADC_SAR_1_Bypass__DM2 EQU CYREG_PRT0_DM2
ADC_SAR_1_Bypass__DR EQU CYREG_PRT0_DR
ADC_SAR_1_Bypass__INP_DIS EQU CYREG_PRT0_INP_DIS
ADC_SAR_1_Bypass__INTTYPE_BASE EQU CYDEV_PICU_INTTYPE_PICU0_BASE
ADC_SAR_1_Bypass__LCD_COM_SEG EQU CYREG_PRT0_LCD_COM_SEG
ADC_SAR_1_Bypass__LCD_EN EQU CYREG_PRT0_LCD_EN
ADC_SAR_1_Bypass__MASK EQU 0x10
ADC_SAR_1_Bypass__PORT EQU 0
ADC_SAR_1_Bypass__PRT EQU CYREG_PRT0_PRT
ADC_SAR_1_Bypass__PRTDSI__CAPS_SEL EQU CYREG_PRT0_CAPS_SEL
ADC_SAR_1_Bypass__PRTDSI__DBL_SYNC_IN EQU CYREG_PRT0_DBL_SYNC_IN
ADC_SAR_1_Bypass__PRTDSI__OE_SEL0 EQU CYREG_PRT0_OE_SEL0
ADC_SAR_1_Bypass__PRTDSI__OE_SEL1 EQU CYREG_PRT0_OE_SEL1
ADC_SAR_1_Bypass__PRTDSI__OUT_SEL0 EQU CYREG_PRT0_OUT_SEL0
ADC_SAR_1_Bypass__PRTDSI__OUT_SEL1 EQU CYREG_PRT0_OUT_SEL1
ADC_SAR_1_Bypass__PRTDSI__SYNC_OUT EQU CYREG_PRT0_SYNC_OUT
ADC_SAR_1_Bypass__PS EQU CYREG_PRT0_PS
ADC_SAR_1_Bypass__SHIFT EQU 4
ADC_SAR_1_Bypass__SLW EQU CYREG_PRT0_SLW
ADC_SAR_1_IRQ__INTC_CLR_EN_REG EQU CYREG_NVIC_CLRENA0
ADC_SAR_1_IRQ__INTC_CLR_PD_REG EQU CYREG_NVIC_CLRPEND0
ADC_SAR_1_IRQ__INTC_MASK EQU 0x01
ADC_SAR_1_IRQ__INTC_NUMBER EQU 0
ADC_SAR_1_IRQ__INTC_PRIOR_NUM EQU 7
ADC_SAR_1_IRQ__INTC_PRIOR_REG EQU CYREG_NVIC_PRI_0
ADC_SAR_1_IRQ__INTC_SET_EN_REG EQU CYREG_NVIC_SETENA0
ADC_SAR_1_IRQ__INTC_SET_PD_REG EQU CYREG_NVIC_SETPEND0
ADC_SAR_1_theACLK__CFG0 EQU CYREG_CLKDIST_ACFG0_CFG0
ADC_SAR_1_theACLK__CFG1 EQU CYREG_CLKDIST_ACFG0_CFG1
ADC_SAR_1_theACLK__CFG2 EQU CYREG_CLKDIST_ACFG0_CFG2
ADC_SAR_1_theACLK__CFG2_SRC_SEL_MASK EQU 0x07
ADC_SAR_1_theACLK__CFG3 EQU CYREG_CLKDIST_ACFG0_CFG3
ADC_SAR_1_theACLK__CFG3_PHASE_DLY_MASK EQU 0x0F
ADC_SAR_1_theACLK__INDEX EQU 0x00
ADC_SAR_1_theACLK__PM_ACT_CFG EQU CYREG_PM_ACT_CFG1
ADC_SAR_1_theACLK__PM_ACT_MSK EQU 0x01
ADC_SAR_1_theACLK__PM_STBY_CFG EQU CYREG_PM_STBY_CFG1
ADC_SAR_1_theACLK__PM_STBY_MSK EQU 0x01

; ADC_SAR_2
ADC_SAR_2_ADC_SAR__CLK EQU CYREG_SAR1_CLK
ADC_SAR_2_ADC_SAR__CSR0 EQU CYREG_SAR1_CSR0
ADC_SAR_2_ADC_SAR__CSR1 EQU CYREG_SAR1_CSR1
ADC_SAR_2_ADC_SAR__CSR2 EQU CYREG_SAR1_CSR2
ADC_SAR_2_ADC_SAR__CSR3 EQU CYREG_SAR1_CSR3
ADC_SAR_2_ADC_SAR__CSR4 EQU CYREG_SAR1_CSR4
ADC_SAR_2_ADC_SAR__CSR5 EQU CYREG_SAR1_CSR5
ADC_SAR_2_ADC_SAR__CSR6 EQU CYREG_SAR1_CSR6
ADC_SAR_2_ADC_SAR__PM_ACT_CFG EQU CYREG_PM_ACT_CFG11
ADC_SAR_2_ADC_SAR__PM_ACT_MSK EQU 0x02
ADC_SAR_2_ADC_SAR__PM_STBY_CFG EQU CYREG_PM_STBY_CFG11
ADC_SAR_2_ADC_SAR__PM_STBY_MSK EQU 0x02
ADC_SAR_2_ADC_SAR__SW0 EQU CYREG_SAR1_SW0
ADC_SAR_2_ADC_SAR__SW2 EQU CYREG_SAR1_SW2
ADC_SAR_2_ADC_SAR__SW3 EQU CYREG_SAR1_SW3
ADC_SAR_2_ADC_SAR__SW4 EQU CYREG_SAR1_SW4
ADC_SAR_2_ADC_SAR__SW6 EQU CYREG_SAR1_SW6
ADC_SAR_2_ADC_SAR__TR0 EQU CYREG_SAR1_TR0
ADC_SAR_2_ADC_SAR__WRK0 EQU CYREG_SAR1_WRK0
ADC_SAR_2_ADC_SAR__WRK1 EQU CYREG_SAR1_WRK1
ADC_SAR_2_Bypass__0__INTTYPE EQU CYREG_PICU0_INTTYPE2
ADC_SAR_2_Bypass__0__MASK EQU 0x04
ADC_SAR_2_Bypass__0__PC EQU CYREG_PRT0_PC2
ADC_SAR_2_Bypass__0__PORT EQU 0
ADC_SAR_2_Bypass__0__SHIFT EQU 2
ADC_SAR_2_Bypass__AG EQU CYREG_PRT0_AG
ADC_SAR_2_Bypass__AMUX EQU CYREG_PRT0_AMUX
ADC_SAR_2_Bypass__BIE EQU CYREG_PRT0_BIE
ADC_SAR_2_Bypass__BIT_MASK EQU CYREG_PRT0_BIT_MASK
ADC_SAR_2_Bypass__BYP EQU CYREG_PRT0_BYP
ADC_SAR_2_Bypass__CTL EQU CYREG_PRT0_CTL
ADC_SAR_2_Bypass__DM0 EQU CYREG_PRT0_DM0
ADC_SAR_2_Bypass__DM1 EQU CYREG_PRT0_DM1
ADC_SAR_2_Bypass__DM2 EQU CYREG_PRT0_DM2
ADC_SAR_2_Bypass__DR EQU CYREG_PRT0_DR
ADC_SAR_2_Bypass__INP_DIS EQU CYREG_PRT0_INP_DIS
ADC_SAR_2_Bypass__INTTYPE_BASE EQU CYDEV_PICU_INTTYPE_PICU0_BASE
ADC_SAR_2_Bypass__LCD_COM_SEG EQU CYREG_PRT0_LCD_COM_SEG
ADC_SAR_2_Bypass__LCD_EN EQU CYREG_PRT0_LCD_EN
ADC_SAR_2_Bypass__MASK EQU 0x04
ADC_SAR_2_Bypass__PORT EQU 0
ADC_SAR_2_Bypass__PRT EQU CYREG_PRT0_PRT
ADC_SAR_2_Bypass__PRTDSI__CAPS_SEL EQU CYREG_PRT0_CAPS_SEL
ADC_SAR_2_Bypass__PRTDSI__DBL_SYNC_IN EQU CYREG_PRT0_DBL_SYNC_IN
ADC_SAR_2_Bypass__PRTDSI__OE_SEL0 EQU CYREG_PRT0_OE_SEL0
ADC_SAR_2_Bypass__PRTDSI__OE_SEL1 EQU CYREG_PRT0_OE_SEL1
ADC_SAR_2_Bypass__PRTDSI__OUT_SEL0 EQU CYREG_PRT0_OUT_SEL0
ADC_SAR_2_Bypass__PRTDSI__OUT_SEL1 EQU CYREG_PRT0_OUT_SEL1
ADC_SAR_2_Bypass__PRTDSI__SYNC_OUT EQU CYREG_PRT0_SYNC_OUT
ADC_SAR_2_Bypass__PS EQU CYREG_PRT0_PS
ADC_SAR_2_Bypass__SHIFT EQU 2
ADC_SAR_2_Bypass__SLW EQU CYREG_PRT0_SLW
ADC_SAR_2_IRQ__INTC_CLR_EN_REG EQU CYREG_NVIC_CLRENA0
ADC_SAR_2_IRQ__INTC_CLR_PD_REG EQU CYREG_NVIC_CLRPEND0
ADC_SAR_2_IRQ__INTC_MASK EQU 0x02
ADC_SAR_2_IRQ__INTC_NUMBER EQU 1
ADC_SAR_2_IRQ__INTC_PRIOR_NUM EQU 7
ADC_SAR_2_IRQ__INTC_PRIOR_REG EQU CYREG_NVIC_PRI_1
ADC_SAR_2_IRQ__INTC_SET_EN_REG EQU CYREG_NVIC_SETENA0
ADC_SAR_2_IRQ__INTC_SET_PD_REG EQU CYREG_NVIC_SETPEND0
ADC_SAR_2_theACLK__CFG0 EQU CYREG_CLKDIST_ACFG1_CFG0
ADC_SAR_2_theACLK__CFG1 EQU CYREG_CLKDIST_ACFG1_CFG1
ADC_SAR_2_theACLK__CFG2 EQU CYREG_CLKDIST_ACFG1_CFG2
ADC_SAR_2_theACLK__CFG2_SRC_SEL_MASK EQU 0x07
ADC_SAR_2_theACLK__CFG3 EQU CYREG_CLKDIST_ACFG1_CFG3
ADC_SAR_2_theACLK__CFG3_PHASE_DLY_MASK EQU 0x0F
ADC_SAR_2_theACLK__INDEX EQU 0x01
ADC_SAR_2_theACLK__PM_ACT_CFG EQU CYREG_PM_ACT_CFG1
ADC_SAR_2_theACLK__PM_ACT_MSK EQU 0x02
ADC_SAR_2_theACLK__PM_STBY_CFG EQU CYREG_PM_STBY_CFG1
ADC_SAR_2_theACLK__PM_STBY_MSK EQU 0x02

; isr_eoc_1
isr_eoc_1__INTC_CLR_EN_REG EQU CYREG_NVIC_CLRENA0
isr_eoc_1__INTC_CLR_PD_REG EQU CYREG_NVIC_CLRPEND0
isr_eoc_1__INTC_MASK EQU 0x04
isr_eoc_1__INTC_NUMBER EQU 2
isr_eoc_1__INTC_PRIOR_NUM EQU 7
isr_eoc_1__INTC_PRIOR_REG EQU CYREG_NVIC_PRI_2
isr_eoc_1__INTC_SET_EN_REG EQU CYREG_NVIC_SETENA0
isr_eoc_1__INTC_SET_PD_REG EQU CYREG_NVIC_SETPEND0

; isr_eoc_2
isr_eoc_2__INTC_CLR_EN_REG EQU CYREG_NVIC_CLRENA0
isr_eoc_2__INTC_CLR_PD_REG EQU CYREG_NVIC_CLRPEND0
isr_eoc_2__INTC_MASK EQU 0x08
isr_eoc_2__INTC_NUMBER EQU 3
isr_eoc_2__INTC_PRIOR_NUM EQU 7
isr_eoc_2__INTC_PRIOR_REG EQU CYREG_NVIC_PRI_3
isr_eoc_2__INTC_SET_EN_REG EQU CYREG_NVIC_SETENA0
isr_eoc_2__INTC_SET_PD_REG EQU CYREG_NVIC_SETPEND0

; isr_timer
isr_timer__INTC_CLR_EN_REG EQU CYREG_NVIC_CLRENA0
isr_timer__INTC_CLR_PD_REG EQU CYREG_NVIC_CLRPEND0
isr_timer__INTC_MASK EQU 0x10
isr_timer__INTC_NUMBER EQU 4
isr_timer__INTC_PRIOR_NUM EQU 7
isr_timer__INTC_PRIOR_REG EQU CYREG_NVIC_PRI_4
isr_timer__INTC_SET_EN_REG EQU CYREG_NVIC_SETENA0
isr_timer__INTC_SET_PD_REG EQU CYREG_NVIC_SETPEND0

; singal_in_1
singal_in_1__0__INTTYPE EQU CYREG_PICU2_INTTYPE2
singal_in_1__0__MASK EQU 0x04
singal_in_1__0__PC EQU CYREG_PRT2_PC2
singal_in_1__0__PORT EQU 2
singal_in_1__0__SHIFT EQU 2
singal_in_1__AG EQU CYREG_PRT2_AG
singal_in_1__AMUX EQU CYREG_PRT2_AMUX
singal_in_1__BIE EQU CYREG_PRT2_BIE
singal_in_1__BIT_MASK EQU CYREG_PRT2_BIT_MASK
singal_in_1__BYP EQU CYREG_PRT2_BYP
singal_in_1__CTL EQU CYREG_PRT2_CTL
singal_in_1__DM0 EQU CYREG_PRT2_DM0
singal_in_1__DM1 EQU CYREG_PRT2_DM1
singal_in_1__DM2 EQU CYREG_PRT2_DM2
singal_in_1__DR EQU CYREG_PRT2_DR
singal_in_1__INP_DIS EQU CYREG_PRT2_INP_DIS
singal_in_1__INTTYPE_BASE EQU CYDEV_PICU_INTTYPE_PICU2_BASE
singal_in_1__LCD_COM_SEG EQU CYREG_PRT2_LCD_COM_SEG
singal_in_1__LCD_EN EQU CYREG_PRT2_LCD_EN
singal_in_1__MASK EQU 0x04
singal_in_1__PORT EQU 2
singal_in_1__PRT EQU CYREG_PRT2_PRT
singal_in_1__PRTDSI__CAPS_SEL EQU CYREG_PRT2_CAPS_SEL
singal_in_1__PRTDSI__DBL_SYNC_IN EQU CYREG_PRT2_DBL_SYNC_IN
singal_in_1__PRTDSI__OE_SEL0 EQU CYREG_PRT2_OE_SEL0
singal_in_1__PRTDSI__OE_SEL1 EQU CYREG_PRT2_OE_SEL1
singal_in_1__PRTDSI__OUT_SEL0 EQU CYREG_PRT2_OUT_SEL0
singal_in_1__PRTDSI__OUT_SEL1 EQU CYREG_PRT2_OUT_SEL1
singal_in_1__PRTDSI__SYNC_OUT EQU CYREG_PRT2_SYNC_OUT
singal_in_1__PS EQU CYREG_PRT2_PS
singal_in_1__SHIFT EQU 2
singal_in_1__SLW EQU CYREG_PRT2_SLW

; singal_in_2
singal_in_2__0__INTTYPE EQU CYREG_PICU2_INTTYPE0
singal_in_2__0__MASK EQU 0x01
singal_in_2__0__PC EQU CYREG_PRT2_PC0
singal_in_2__0__PORT EQU 2
singal_in_2__0__SHIFT EQU 0
singal_in_2__AG EQU CYREG_PRT2_AG
singal_in_2__AMUX EQU CYREG_PRT2_AMUX
singal_in_2__BIE EQU CYREG_PRT2_BIE
singal_in_2__BIT_MASK EQU CYREG_PRT2_BIT_MASK
singal_in_2__BYP EQU CYREG_PRT2_BYP
singal_in_2__CTL EQU CYREG_PRT2_CTL
singal_in_2__DM0 EQU CYREG_PRT2_DM0
singal_in_2__DM1 EQU CYREG_PRT2_DM1
singal_in_2__DM2 EQU CYREG_PRT2_DM2
singal_in_2__DR EQU CYREG_PRT2_DR
singal_in_2__INP_DIS EQU CYREG_PRT2_INP_DIS
singal_in_2__INTTYPE_BASE EQU CYDEV_PICU_INTTYPE_PICU2_BASE
singal_in_2__LCD_COM_SEG EQU CYREG_PRT2_LCD_COM_SEG
singal_in_2__LCD_EN EQU CYREG_PRT2_LCD_EN
singal_in_2__MASK EQU 0x01
singal_in_2__PORT EQU 2
singal_in_2__PRT EQU CYREG_PRT2_PRT
singal_in_2__PRTDSI__CAPS_SEL EQU CYREG_PRT2_CAPS_SEL
singal_in_2__PRTDSI__DBL_SYNC_IN EQU CYREG_PRT2_DBL_SYNC_IN
singal_in_2__PRTDSI__OE_SEL0 EQU CYREG_PRT2_OE_SEL0
singal_in_2__PRTDSI__OE_SEL1 EQU CYREG_PRT2_OE_SEL1
singal_in_2__PRTDSI__OUT_SEL0 EQU CYREG_PRT2_OUT_SEL0
singal_in_2__PRTDSI__OUT_SEL1 EQU CYREG_PRT2_OUT_SEL1
singal_in_2__PRTDSI__SYNC_OUT EQU CYREG_PRT2_SYNC_OUT
singal_in_2__PS EQU CYREG_PRT2_PS
singal_in_2__SHIFT EQU 0
singal_in_2__SLW EQU CYREG_PRT2_SLW

; Miscellaneous
BCLK__BUS_CLK__HZ EQU 24000000
BCLK__BUS_CLK__KHZ EQU 24000
BCLK__BUS_CLK__MHZ EQU 24
CYDEV_CHIP_DIE_LEOPARD EQU 1
CYDEV_CHIP_DIE_PSOC4A EQU 18
CYDEV_CHIP_DIE_PSOC5LP EQU 2
CYDEV_CHIP_DIE_PSOC5TM EQU 3
CYDEV_CHIP_DIE_TMA4 EQU 4
CYDEV_CHIP_DIE_UNKNOWN EQU 0
CYDEV_CHIP_FAMILY_FM0P EQU 5
CYDEV_CHIP_FAMILY_FM3 EQU 6
CYDEV_CHIP_FAMILY_FM4 EQU 7
CYDEV_CHIP_FAMILY_PSOC3 EQU 1
CYDEV_CHIP_FAMILY_PSOC4 EQU 2
CYDEV_CHIP_FAMILY_PSOC5 EQU 3
CYDEV_CHIP_FAMILY_PSOC6 EQU 4
CYDEV_CHIP_FAMILY_UNKNOWN EQU 0
CYDEV_CHIP_FAMILY_USED EQU CYDEV_CHIP_FAMILY_PSOC5
CYDEV_CHIP_JTAG_ID EQU 0x2E161069
CYDEV_CHIP_MEMBER_3A EQU 1
CYDEV_CHIP_MEMBER_4A EQU 18
CYDEV_CHIP_MEMBER_4D EQU 13
CYDEV_CHIP_MEMBER_4E EQU 6
CYDEV_CHIP_MEMBER_4F EQU 19
CYDEV_CHIP_MEMBER_4G EQU 4
CYDEV_CHIP_MEMBER_4H EQU 17
CYDEV_CHIP_MEMBER_4I EQU 23
CYDEV_CHIP_MEMBER_4J EQU 14
CYDEV_CHIP_MEMBER_4K EQU 15
CYDEV_CHIP_MEMBER_4L EQU 22
CYDEV_CHIP_MEMBER_4M EQU 21
CYDEV_CHIP_MEMBER_4N EQU 10
CYDEV_CHIP_MEMBER_4O EQU 7
CYDEV_CHIP_MEMBER_4P EQU 20
CYDEV_CHIP_MEMBER_4Q EQU 12
CYDEV_CHIP_MEMBER_4R EQU 8
CYDEV_CHIP_MEMBER_4S EQU 11
CYDEV_CHIP_MEMBER_4T EQU 9
CYDEV_CHIP_MEMBER_4U EQU 5
CYDEV_CHIP_MEMBER_4V EQU 16
CYDEV_CHIP_MEMBER_5A EQU 3
CYDEV_CHIP_MEMBER_5B EQU 2
CYDEV_CHIP_MEMBER_6A EQU 24
CYDEV_CHIP_MEMBER_FM3 EQU 28
CYDEV_CHIP_MEMBER_FM4 EQU 29
CYDEV_CHIP_MEMBER_PDL_FM0P_TYPE1 EQU 25
CYDEV_CHIP_MEMBER_PDL_FM0P_TYPE2 EQU 26
CYDEV_CHIP_MEMBER_PDL_FM0P_TYPE3 EQU 27
CYDEV_CHIP_MEMBER_UNKNOWN EQU 0
CYDEV_CHIP_MEMBER_USED EQU CYDEV_CHIP_MEMBER_5B
CYDEV_CHIP_DIE_EXPECT EQU CYDEV_CHIP_MEMBER_USED
CYDEV_CHIP_DIE_ACTUAL EQU CYDEV_CHIP_DIE_EXPECT
CYDEV_CHIP_REV_LEOPARD_ES1 EQU 0
CYDEV_CHIP_REV_LEOPARD_ES2 EQU 1
CYDEV_CHIP_REV_LEOPARD_ES3 EQU 3
CYDEV_CHIP_REV_LEOPARD_PRODUCTION EQU 3
CYDEV_CHIP_REV_PSOC4A_ES0 EQU 17
CYDEV_CHIP_REV_PSOC4A_PRODUCTION EQU 17
CYDEV_CHIP_REV_PSOC5LP_ES0 EQU 0
CYDEV_CHIP_REV_PSOC5LP_PRODUCTION EQU 0
CYDEV_CHIP_REV_PSOC5TM_ES0 EQU 0
CYDEV_CHIP_REV_PSOC5TM_ES1 EQU 1
CYDEV_CHIP_REV_PSOC5TM_PRODUCTION EQU 1
CYDEV_CHIP_REV_TMA4_ES EQU 17
CYDEV_CHIP_REV_TMA4_ES2 EQU 33
CYDEV_CHIP_REV_TMA4_PRODUCTION EQU 17
CYDEV_CHIP_REVISION_3A_ES1 EQU 0
CYDEV_CHIP_REVISION_3A_ES2 EQU 1
CYDEV_CHIP_REVISION_3A_ES3 EQU 3
CYDEV_CHIP_REVISION_3A_PRODUCTION EQU 3
CYDEV_CHIP_REVISION_4A_ES0 EQU 17
CYDEV_CHIP_REVISION_4A_PRODUCTION EQU 17
CYDEV_CHIP_REVISION_4D_PRODUCTION EQU 0
CYDEV_CHIP_REVISION_4E_CCG2_NO_USBPD EQU 0
CYDEV_CHIP_REVISION_4E_PRODUCTION EQU 0
CYDEV_CHIP_REVISION_4F_PRODUCTION EQU 0
CYDEV_CHIP_REVISION_4F_PRODUCTION_256DMA EQU 0
CYDEV_CHIP_REVISION_4F_PRODUCTION_256K EQU 0
CYDEV_CHIP_REVISION_4G_ES EQU 17
CYDEV_CHIP_REVISION_4G_ES2 EQU 33
CYDEV_CHIP_REVISION_4G_PRODUCTION EQU 17
CYDEV_CHIP_REVISION_4H_PRODUCTION EQU 0
CYDEV_CHIP_REVISION_4I_PRODUCTION EQU 0
CYDEV_CHIP_REVISION_4J_PRODUCTION EQU 0
CYDEV_CHIP_REVISION_4K_PRODUCTION EQU 0
CYDEV_CHIP_REVISION_4L_PRODUCTION EQU 0
CYDEV_CHIP_REVISION_4M_PRODUCTION EQU 0
CYDEV_CHIP_REVISION_4N_PRODUCTION EQU 0
CYDEV_CHIP_REVISION_4O_PRODUCTION EQU 0
CYDEV_CHIP_REVISION_4P_PRODUCTION EQU 0
CYDEV_CHIP_REVISION_4Q_PRODUCTION EQU 0
CYDEV_CHIP_REVISION_4R_PRODUCTION EQU 0
CYDEV_CHIP_REVISION_4S_PRODUCTION EQU 0
CYDEV_CHIP_REVISION_4T_PRODUCTION EQU 0
CYDEV_CHIP_REVISION_4U_PRODUCTION EQU 0
CYDEV_CHIP_REVISION_4V_PRODUCTION EQU 0
CYDEV_CHIP_REVISION_5A_ES0 EQU 0
CYDEV_CHIP_REVISION_5A_ES1 EQU 1
CYDEV_CHIP_REVISION_5A_PRODUCTION EQU 1
CYDEV_CHIP_REVISION_5B_ES0 EQU 0
CYDEV_CHIP_REVISION_5B_PRODUCTION EQU 0
CYDEV_CHIP_REVISION_6A_ES EQU 17
CYDEV_CHIP_REVISION_6A_NO_UDB EQU 33
CYDEV_CHIP_REVISION_6A_PRODUCTION EQU 33
CYDEV_CHIP_REVISION_FM3_PRODUCTION EQU 0
CYDEV_CHIP_REVISION_FM4_PRODUCTION EQU 0
CYDEV_CHIP_REVISION_PDL_FM0P_TYPE1_PRODUCTION EQU 0
CYDEV_CHIP_REVISION_PDL_FM0P_TYPE2_PRODUCTION EQU 0
CYDEV_CHIP_REVISION_PDL_FM0P_TYPE3_PRODUCTION EQU 0
CYDEV_CHIP_REVISION_USED EQU CYDEV_CHIP_REVISION_5B_PRODUCTION
CYDEV_CHIP_REV_EXPECT EQU CYDEV_CHIP_REVISION_USED
CYDEV_CONFIG_FASTBOOT_ENABLED EQU 1
CYDEV_CONFIG_UNUSED_IO_AllowButWarn EQU 0
CYDEV_CONFIG_UNUSED_IO EQU CYDEV_CONFIG_UNUSED_IO_AllowButWarn
CYDEV_CONFIG_UNUSED_IO_AllowWithInfo EQU 1
CYDEV_CONFIG_UNUSED_IO_Disallowed EQU 2
CYDEV_CONFIGURATION_COMPRESSED EQU 1
CYDEV_CONFIGURATION_DMA EQU 0
CYDEV_CONFIGURATION_ECC EQU 1
CYDEV_CONFIGURATION_IMOENABLED EQU CYDEV_CONFIG_FASTBOOT_ENABLED
CYDEV_CONFIGURATION_MODE_COMPRESSED EQU 0
CYDEV_CONFIGURATION_MODE EQU CYDEV_CONFIGURATION_MODE_COMPRESSED
CYDEV_CONFIGURATION_MODE_DMA EQU 2
CYDEV_CONFIGURATION_MODE_UNCOMPRESSED EQU 1
CYDEV_DEBUG_ENABLE_MASK EQU 0x20
CYDEV_DEBUG_ENABLE_REGISTER EQU CYREG_MLOGIC_DEBUG
CYDEV_DEBUGGING_DPS_Disable EQU 3
CYDEV_DEBUGGING_DPS_JTAG_4 EQU 1
CYDEV_DEBUGGING_DPS_JTAG_5 EQU 0
CYDEV_DEBUGGING_DPS_SWD EQU 2
CYDEV_DEBUGGING_DPS_SWD_SWV EQU 6
CYDEV_DEBUGGING_DPS EQU CYDEV_DEBUGGING_DPS_SWD_SWV
CYDEV_DEBUGGING_ENABLE EQU 1
CYDEV_DEBUGGING_XRES EQU 0
CYDEV_DMA_CHANNELS_AVAILABLE EQU 24
CYDEV_ECC_ENABLE EQU 0
CYDEV_HEAP_SIZE EQU 0x80
CYDEV_INSTRUCT_CACHE_ENABLED EQU 1
CYDEV_INTR_RISING EQU 0x0000000F
CYDEV_IS_EXPORTING_CODE EQU 0
CYDEV_IS_IMPORTING_CODE EQU 0
CYDEV_PROJ_TYPE EQU 0
CYDEV_PROJ_TYPE_BOOTLOADER EQU 1
CYDEV_PROJ_TYPE_LAUNCHER EQU 5
CYDEV_PROJ_TYPE_LOADABLE EQU 2
CYDEV_PROJ_TYPE_LOADABLEANDBOOTLOADER EQU 4
CYDEV_PROJ_TYPE_MULTIAPPBOOTLOADER EQU 3
CYDEV_PROJ_TYPE_STANDARD EQU 0
CYDEV_PROTECTION_ENABLE EQU 0
CYDEV_STACK_SIZE EQU 0x0800
CYDEV_USE_BUNDLED_CMSIS EQU 1
CYDEV_VARIABLE_VDDA EQU 0
CYDEV_VDDA_MV EQU 5000
CYDEV_VDDD_MV EQU 5000
CYDEV_VDDIO0_MV EQU 5000
CYDEV_VDDIO1_MV EQU 5000
CYDEV_VDDIO2_MV EQU 5000
CYDEV_VDDIO3_MV EQU 5000
CYDEV_VIO0_MV EQU 5000
CYDEV_VIO1_MV EQU 5000
CYDEV_VIO2_MV EQU 5000
CYDEV_VIO3_MV EQU 5000
CYIPBLOCK_ARM_CM3_VERSION EQU 0
CYIPBLOCK_P3_ANAIF_VERSION EQU 0
CYIPBLOCK_P3_CAN_VERSION EQU 0
CYIPBLOCK_P3_CAPSENSE_VERSION EQU 0
CYIPBLOCK_P3_COMP_VERSION EQU 0
CYIPBLOCK_P3_DECIMATOR_VERSION EQU 0
CYIPBLOCK_P3_DFB_VERSION EQU 0
CYIPBLOCK_P3_DMA_VERSION EQU 0
CYIPBLOCK_P3_DRQ_VERSION EQU 0
CYIPBLOCK_P3_DSM_VERSION EQU 0
CYIPBLOCK_P3_EMIF_VERSION EQU 0
CYIPBLOCK_P3_I2C_VERSION EQU 0
CYIPBLOCK_P3_LCD_VERSION EQU 0
CYIPBLOCK_P3_LPF_VERSION EQU 0
CYIPBLOCK_P3_OPAMP_VERSION EQU 0
CYIPBLOCK_P3_PM_VERSION EQU 0
CYIPBLOCK_P3_SCCT_VERSION EQU 0
CYIPBLOCK_P3_TIMER_VERSION EQU 0
CYIPBLOCK_P3_USB_VERSION EQU 0
CYIPBLOCK_P3_VIDAC_VERSION EQU 0
CYIPBLOCK_P3_VREF_VERSION EQU 0
CYIPBLOCK_S8_GPIO_VERSION EQU 0
CYIPBLOCK_S8_IRQ_VERSION EQU 0
CYIPBLOCK_S8_SAR_VERSION EQU 0
CYIPBLOCK_S8_SIO_VERSION EQU 0
CYIPBLOCK_S8_UDB_VERSION EQU 0
DMA_CHANNELS_USED__MASK0 EQU 0x00000000
CYDEV_BOOTLOADER_ENABLE EQU 0
    ENDIF
    END
